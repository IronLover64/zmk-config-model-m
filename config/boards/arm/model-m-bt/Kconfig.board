## config/boards/arm/model-m-bt/Kconfig.board
```kconfig
# Copyright (c) 2021 Nick Winans
# SPDX-License-Identifier: MIT

config BOARD_MODEL_M
    bool "model-m-bt"
    depends on SOC_NRF52840_QIAA
```

## config/boards/arm/model-m-bt/Kconfig.defconfig
```kconfig
# Copyright (c) 2021 Nick Winans
# SPDX-License-Identifier: MIT

if BOARD_MODEL_M

config ZMK_KEYBOARD_NAME
    default "model-m-bt"

if USB_DEVICE_STACK

config USB_NRFX
    default y

endif # USB_DEVICE_STACK

config BT_CTLR
    default BT

endif # BOARD_MODEL_M
```

## config/boards/arm/nice60/Kconfig.board
```kconfig
# Copyright (c) 2021 Nick Winans
# SPDX-License-Identifier: MIT

config model-m-nrf
    bool "nrfmicro_13"
    depends on SOC_NRF52840_QIAA
```
